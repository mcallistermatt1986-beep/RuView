## firmware/esp32-gamma-stim/main/Kconfig.projbuild
```kconfig
menu "Gamma Stimulation (ADR-250)"

config GAMMA_STIM_LED_GPIO
    int "LED PWM output GPIO"
    default 4
    help
        GPIO driving the LED MOSFET/driver. The 36-44 Hz stimulus is the
        envelope on a 19.5 kHz PWM carrier.

config GAMMA_STIM_AUDIO_GPIO
    int "Audio tone output GPIO"
    default 5
    help
        GPIO driving the speaker/buzzer amplifier input (square tone,
        envelope-gated). Use an analog volume stage for real loudness control.

config GAMMA_STIM_SYNC_GPIO
    int "Sync-out GPIO (HIL measurement)"
    default 6
    help
        Mirrors the stimulation envelope for photodiode/logic-analyzer
        verification of the +/-0.1 Hz and <5 ms A/V sync HIL targets.

config GAMMA_STIM_ESTOP_GPIO
    int "Emergency-stop button GPIO (active low)"
    default 7
    help
        Button to GND. Falling edge latches an emergency stop: the output
        gate GPIO is driven low in the ISR (direct register write), sessions
        refused until UNLOCK. UNLOCK is refused while the button is still
        held. Stop latency target <100 ms; the gate write achieves
        microseconds.

config GAMMA_STIM_GATE_GPIO
    int "Output-enable gate GPIO (hard off path)"
    default 10
    help
        Plain GPIO that enables BOTH the LED driver and the audio amplifier
        (hardware AND with the LEDC carriers). The half-period ISR toggles it
        to deliver the 36-44 Hz envelope, and the e-stop ISR / dead-man
        watchdog force it low with a direct register write — the <100 ms
        stop guarantee rests on this pin, NOT on the LEDC driver. Wire it to
        the driver/amplifier enable inputs with an external pulldown so the
        outputs stay disabled while the pin floats during boot/reset. Avoid
        strapping pins (e.g. GPIO8/GPIO9 on ESP32-C6).

config GAMMA_STIM_AUDIO_TONE_HZ
    int "Audio tone carrier frequency (Hz)"
    range 200 2000
    default 440
    help
        The audible tone gated at the stimulation frequency. GENUS-style
        protocols use a click/tone burst per cycle.

endmenu
```
